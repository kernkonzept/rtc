## Kconfig.L4
```kconfig
menu "RTC"

config RTC_DS3231
        bool "DS3231"
        depends on HAVE_BIDPC_I2C_DRIVER
        default n

comment "DS3231 RTC not available due to missing i2c-driver package"
        depends on !HAVE_BIDPC_I2C_DRIVER

endmenu
```
